## app/boards/shields/yackboard/Kconfig.shield
```kconfig
#
# Configuration that defines the shield.
#

config SHIELD_YACKBOARD
  def_bool $(shields_list_contains,yackboard)

config SHIELD_YACKBOARD_LEFT
  def_bool $(shields_list_contains,yackboard_left)

config SHIELD_YACKBOARD_RIGHT
  def_bool $(shields_list_contains,yackboard_right)

#
# End of file.
#
```
